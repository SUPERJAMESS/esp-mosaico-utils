// Generated by tools/build_vibe_ui.py; do not edit.
static const struct { const char *en, *zh; } vibe_translations[] = {
    {"Ready for your next idea", "准备好迎接下一个创意"},
    {"Network", "网络"},
    {"Download Ideas", "下载 Idea"},
    {"My Ideas", "我的 Ideas"},
    {"TCP pairing", "TCP 配对"},
    {"Forget", "忘记"},
    {"Rescan", "重新扫描"},
    {"Join network", "连接网络"},
    {"DEVICE ENDPOINT", "设备地址"},
    {"PAIRING TOKEN", "配对信息"},
    {"Enter this token once in the Gateway.\nIt never crosses the TCP link.", "在 Gateway 中输入此配对信息。\n配对信息不会通过 TCP 链路传输。"},
    {"Available after startup", "启动后可用"},
    {"APPLICATION CODE", "IDEA 编号"},
    {"View app", "查看 Idea"},
    {"Idea details", "Idea 详情"},
    {"DOWNLOADED IDEA", "本机 IDEA"},
    {"After setup, this Idea starts on power-on.\nKeep power connected during setup.", "点击打开后将自动重启运行。\n请在写入期间保持供电。"},
    {"Back", "返回"},
    {"Set as boot application", "设为开机应用"},
    {"Session owner", "连接来源"},
    {"Verification", "校验"},
    {"Keep power connected until restart.", "请保持供电，直到设备重启。"},
    {"Vibe Mode home", "Vibe Mode 首页"},
    {"Delete", "删除"},
    {"Check updates", "检查更新"},
    {"Download latest", "下载新版"},
    {"Restart now", "立即重启"},
    {"View info", "查看介绍"},
    {"App information", "创意介绍"},
    {"Cancel", "取消"},
    {" | Boot app", " | 当前应用"},
    {" | Update", " | 有更新"},
    {"%s\nTransferred: %u%%", "%s\n已传输：%u%%"},
    {"%u Ideas downloaded", "已下载 %u 个 Idea"},
    {"%u networks found", "找到 %u 个网络"},
    {"%u/%u components verified", "已校验 %u/%u 个组件"},
    {"Active", "使用中"},
    {"Already downloaded", "已经下载"},
    {"App information failed", "读取信息失败"},
    {"Application image", "应用镜像"},
    {"Available", "可用"},
    {"Check password and try again", "请检查密码后重试"},
    {"Choose a network below", "请选择下方网络"},
    {"Component %u: %u%% | %u/%u verified", "组件 %u：%u%% | 已校验 %u/%u"},
    {"Confirm to save in My Ideas", "确认后保存到我的 Idea"},
    {"Connect Wi-Fi first", "请先连接 Wi-Fi"},
    {"Connect Wi-Fi to download ideas", "请连接 Wi-Fi 后下载 Idea"},
    {"Connecting", "连接中"},
    {"Connecting...", "正在连接…"},
    {"Connection failed", "连接失败"},
    {"Download", "下载"},
    {"Enter all six digits", "请输入完整的六位编号"},
    {"Enter password", "输入密码"},
    {"Enter the six-digit Idea code", "请输入六位 Idea 编号"},
    {"Error 0x%08x\nReturn home and retry", "错误 0x%08x\n请返回首页后重试"},
    {"Fetching details from the cloud", "正在获取云端详情"},
    {"Finishing previous request...", "正在完成上一次操作…"},
    {"Hide", "隐藏"},
    {"Idea %s", "创意 %s"},
    {"Installation failed", "安装失败"},
    {"Open failed", "打开失败"},
    {"Loading app information...", "正在读取 Idea 信息…"},
    {"NAND unavailable: 0x%x", "NAND 不可用：0x%x"},
    {"Network setup not completed", "尚未连接网络"},
    {"No boot application", "尚未设置启动应用"},
    {"Not connected", "未连接"},
    {"Offline", "离线"},
    {"Open", "打开"},
    {"Pairing token unavailable", "配对信息不可用"},
    {"Paused", "已暂停"},
    {"Please wait", "请稍候"},
    {"Read", "读取"},
    {"Reading downloaded resources", "正在读取本地资源"},
    {"Receive", "接收"},
    {"Saved in My Ideas", "已保存在我的 Idea"},
    {"Scan error 0x%x", "扫描失败 0x%x"},
    {"Scanning...", "正在扫描…"},
    {"Secured", "加密"},
    {"Setting boot application", "正在准备打开 Idea"},
    {"Show", "显示"},
    {"USB remains available offline", "离线时仍可通过 USB 连接"},
    {"Validating", "正在校验"},
    {"Verifying downloaded files", "正在校验本地文件"},
    {"View info for name and description", "查看 Idea 的名称与介绍"},
    {"Wi-Fi is not connected", "Wi-Fi 未连接"},
    {"Available networks", "可用网络"},
    {"Details", "详情"},
    {"Open to scan", "打开以扫描"},
    {"Updating system", "正在更新系统"},
    {"Preparing update", "正在准备更新"},
    {"Update complete", "更新完成"},
    {"System images verified", "系统镜像已校验"},
    {"Awaiting component verification", "等待校验组件"},
    {"Awaiting image verification", "等待校验镜像"},
    {"Committing protected system images", "正在提交系统镜像"},
    {"Component verified", "组件已校验"},
    {"Downloading system component", "正在下载系统组件"},
    {"Error 0x%08x - reconnect and retry", "错误 0x%08x，请重新连接后重试"},
    {"Error 0x%08x - rescan or use USB", "错误 0x%08x，请重新扫描或使用 USB"},
    {"Error 0x%08x - use USB to retry", "错误 0x%08x，请使用 USB 重试"},
    {"Firmware update failed", "固件更新失败"},
    {"Firmware verified", "固件已校验"},
    {"Installing downloaded files", "正在写入已下载的文件"},
    {"NAND update failed", "NAND 更新失败"},
    {"Opening NAND firmware bundle", "正在打开 NAND 固件包"},
    {"Reading NAND system component", "正在读取 NAND 系统组件"},
    {"Receiving application", "正在接收应用"},
    {"Receiving system component", "正在接收系统组件"},
    {"Restarting into the application", "正在重启进入应用"},
    {"Selecting boot application", "正在设置启动应用"},
    {"System images verified and committed", "系统镜像已校验并提交"},
    {"Unsigned", "未签名"},
    {"Update failed", "更新失败"},
    {"Updating firmware", "正在更新固件"},
    {"Validating unsigned update plan", "正在校验更新清单"},
    {"Downloading Idea", "正在下载 Idea"},
    {"Transferring files", "正在传输文件"},
    {"Verifying files", "正在校验文件"},
    {"Checking image", "正在检查镜像"},
    {"Saving Idea", "正在保存创意"},
    {"Idea saved", "保存完成"},
    {"Files verified: %u/%u", "已校验文件：%u/%u"},
    {"Saving and verifying files in NAND", "正在保存并校验 NAND 文件"},
    {"Download complete", "下载完成"},
    {"Saved in My Ideas.\nSelect it to set as boot app.", "已保存在我的 Idea。\n点击打开即可运行。"},
    {"Boot application ready", "Idea 已准备就绪"},
    {"Starts on next power-on.\nRestart to run it now.", "重启即可运行这个 Idea。"},
    {"Already up to date", "已经是最新版本"},
    {"The downloaded Idea is up to date.", "本机 Idea 已经是最新版本。"},
    {"Loading app information", "正在读取 Idea 信息"},
    {"Download failed", "下载失败"},
    {"Language change failed", "切换语言失败"},
    {"English", "English"},
    {"Keep power connected until saved.", "保存完成前请保持供电。"},
    {"%s\nVerified: %u%%", "%s\n已校验：%u%%"},
    {"Vibe Mode", "Vibe Mode"},
    {"Bring your Ideas to life", "让 Idea 跑起来"},
    {"Make one. Download one. Run it here.", "下载现成的，或亲手做一个。"},
    {"Develop", "开发"},
    {"Manage", "管理"},
    {"Settings", "设置"},
    {"Swipe left for your Ideas  ›", "向左滑动查看你的 Idea  ›"},
    {"Undo", "撤销"},
    {"Manage Ideas", "管理 Idea"},
    {"Update all", "全部更新"},
    {"USB connection", "USB 连接"},
    {"Waiting for your Agent", "等待 Agent 连接"},
    {"No development Idea", "没有开发版本"},
    {"Save to NAND", "保存到 NAND"},
    {"Hold AI and double-press Power\nto return to Vibe Mode", "按住 AI 键不放，双击开关机键\n即可回到 Vibe Mode"},
    {"Display & haptics", "显示与触感"},
    {"Language", "语言"},
    {"Shared information", "共享信息"},
    {"About & help", "关于与帮助"},
    {"Reset settings", "恢复出厂设置"},
    {"Brightness", "亮度"},
    {"Screen off", "自动息屏"},
    {"Never", "从不"},
    {"Auto rotate: on", "自动旋转：开"},
    {"Auto rotate: off", "自动旋转：关"},
    {"Haptics: on", "触感：开"},
    {"Haptics: off", "触感：关"},
    {"Welcome to Vibe Mode", "欢迎使用 Vibe Mode"},
    {"Choose your language", "选择语言"},
    {"简体中文", "简体中文"},
    {"Key", "键名"},
    {"Value", "内容"},
    {"Next", "下一步"},
    {"Save", "保存"},
    {"Find Ideas", "查找 Idea"},
    {"Hold AI and double-press Power\nto return to Vibe Mode.\nHold Boot during reset for ROM Download Mode.", "按住 AI 键不放，双击开关机键\n即可回到 Vibe Mode。\n复位时按住 Boot 键进入 ROM 下载模式。"},
    {"Clear Wi-Fi, shared information\nand system preferences.\nNAND and all saved Ideas are kept.", "清除 Wi-Fi、共享信息和系统偏好。\n保留 NAND 和所有已保存的 Idea。"},
    {"Hold for 3 seconds to reset", "长按 3 秒恢复出厂设置"},
    {"Hold for 3 seconds to delete", "长按 3 秒删除"},
    {"Open Idea", "打开 Idea"},
    {"Leave Vibe Mode and open this Idea?", "离开 Vibe Mode 并打开这个 Idea？"},
    {"Unsaved development will be replaced.", "未保存的开发版本将被覆盖。"},
    {"The device will restart.", "设备将重启运行这个 Idea。"},
    {"Delete Idea", "删除 Idea"},
    {"Remove this saved Idea?\nYou can undo for 4 seconds.", "删除这个已保存的 Idea？\n删除后 4 秒内可以撤销。"},
    {"Touch or pick up to wake", "轻触或拿起以唤醒"},
    {"ROM Download Mode", "ROM 下载模式"},
    {"Hold Boot and double-press Power.\nThe chip will enter ROM Download Mode.\nVibe Mode does not run in that mode.", "按住 Boot 键，双击开关机键。\n芯片将进入 ROM 下载模式。\n该模式不运行 Vibe Mode。"},
    {"Connected", "已连接"},
    {"USB connected · Agent ready", "USB 已连接，Agent 已就绪"},
    {"USB connected · waiting for Agent", "USB 已连接，等待 Agent"},
    {"USB not connected", "USB 未连接"},
    {"Cancelling...", "正在取消…"},
    {"Reading and verifying files", "正在读取并校验文件"},
    {"Checking installed application", "正在检查已安装应用"},
    {"Preparing application", "正在准备应用"},
    {"Writing application", "正在写入应用"},
    {"Write", "写入"},
    {"Checking application manifest", "正在检查应用清单"},
    {"Connect USB to your computer", "请连接电脑 USB"},
    {"Saved", "已保存"},
    {"Ready to save", "可保存到本机"},
    {"Operation failed", "操作失败"},
    {"Error", "错误"},
    {"Low battery", "电量低"},
    {"Charge above 20% or connect USB.", "请充电至 20% 以上或连接 USB。"},
    {"Cannot delete the current Idea", "不能删除当前 Idea"},
    {"Request failed", "请求失败"},
    {"Saved copies are ready to open", "已保存的版本可以打开"},
    {"Development Idea saved", "开发版本已保存"},
    {"Saving development Idea", "正在保存开发版本"},
    {"Reading application and resources", "正在读取应用和资源"},
    {"Idea deleted", "Idea 已删除"},
    {"Removed from this device", "已从本机删除"},
    {"Ideas up to date", "Idea 已是最新"},
    {"Cancelled", "已取消"},
    {"Previously saved Ideas are unchanged", "原有完整版本已保留"},
    {"NAND unchanged", "NAND 内容已保留"},
    {"Saving settings...", "正在保存设置…"},
    {"Hold · %u s", "继续按住 · %u 秒"},
    {"Deleted · %u s to undo", "已删除 · %u 秒内可撤销"},
    {"Brightness %u%% · timeout %u s", "亮度 %u%% · 息屏 %u 秒"},
    {"Storage: %llu / %llu MiB", "存储：%llu / %llu MiB"},
    {"Page %u / %u", "第 %u / %u 页"},
    {"Unknown", "未知"},
    {"Skip", "跳过"},
    {"Finish", "完成"},
    {"Please use a-z, 0-9 and _", "仅支持 a-z、0-9 和下划线"},
    {"Choose Wi-Fi or skip for now", "连接 Wi-Fi，也可以稍后设置"},
    {"Shared information saved", "共享信息已保存"},
    {"Empty · add a shared value", "暂无共享信息，点击添加"},
    {"Boot app", "当前应用"},
    {"Update", "更新"},
    {"Local development", "本地开发版"},
    {"On", "开"},
    {"Off", "关"},
    {"Run", "运行"},
    {"Always ask before opening", "每次打开前询问"},
    {"Skip this prompt next time", "下次不再提示"},
    {"Undo · %u s", "撤销 · %u 秒"},
    {"Saved in My Ideas.\nChoose Open to run it.", "已保存在我的 Idea。\n点击打开即可运行。"},
    {"Available in My Ideas", "可以从我的 Idea 打开"},
    {"NAND bundle", "NAND 固件包"},
    {"Cloud", "云端"},
    {"Development Idea", "开发版本"},
    {"Saved from USB development. Available offline.", "从 USB 开发版本保存，可离线运行。"},
    {"Not enough space", "存储空间不足"},
    {"Free space or delete an Idea, then retry.", "请删除一些 Idea 释放空间后重试。"},
    {"No Idea with this ID", "没有找到这个 ID 对应的 Idea"},
    {"Updating · %u%%", "正在更新 · %u%%"},
    {"Waiting", "等待中"},
    {"Device", "设备"},
    {"%u Ideas", "%u 个 Idea"},
    {"Home", "首页"},
    {"Ideas", "Idea"},
    {"Make Ideas", "让 Idea"},
    {"Download or build Ideas,", "下载现成的，或亲手做一个，"},
    {"then run them here.", "都能在这里运行。"},
    {"Build one", "动手做一个"},
    {"Download · update", "下载 · 更新"},
    {"Vibe-code an Idea", "Vibe 编程一个 Idea"},
    {"Scan for the step-by-step guide", "扫码查看分步指南"},
    {"Install over USB", "通过 USB 安装"},
    {"Ask your agent to install it here.", "让你的 Agent 把它装到这里。"},
    {"Save to NAND flash", "存入 NAND 闪存"},
    {"Back to Vibe Mode: hold AI and\ndouble-press power to restart.", "回到 Vibe Mode：按住 AI 键，\n双击开关机键重启。"},
    {"Help", "帮助"},
    {"Get started with Vibe Mode", "开始使用 Vibe Mode"},
    {"About", "关于"},
    {"Version · device · storage", "版本 · 设备 · 存储"},
    {"Factory reset", "恢复出厂设置"},
    {"Clear preferences · keep NAND", "清除偏好 · 保留 NAND"},
    {"Shared info", "共享信息"},
    {"Screen off after 3 min", "3 分钟后息屏"},
    {"No Ideas yet", "还没有 Idea"},
    {"Tap + to download your first Idea.", "点击 + 下载你的第一个 Idea。"},
    {"Download Idea", "下载 Idea"},
    {"Enter the 6-digit ID from Mosaico Ideas", "输入 Mosaico Ideas 的六位编号"},
    {"Go", "前往"},
    {"BRIGHTNESS", "亮度"},
    {"SCREEN OFF", "自动息屏"},
    {"Auto rotate", "自动旋转"},
    {"Follows how you hold it", "随设备方向旋转"},
    {"Haptics", "触感"},
    {"Ticks when you press keys", "按键时提供触感反馈"},
    {"Add entry", "添加条目"},
    {"No shared info yet", "还没有共享信息"},
    {"Save a value once, like your city,", "只需保存一次，例如你所在的城市，"},
    {"and every Idea can read it.", "所有 Idea 都可以读取。"},
    {"Version", "版本"},
    {"Storage", "存储"},
    {"Connect your development tools", "连接你的开发工具"},
    {"Browse Mosaico Ideas", "浏览 Mosaico Ideas"},
    {"Done", "完成"},
    {"Hold to reset", "长按恢复出厂设置"},
    {"Hold to delete", "长按删除"},
    {"%u Ideas · %llu of %llu MiB used", "%u 个 Idea · 已用 %llu / %llu MiB"},
    {"%u entries", "%u 个条目"},
    {"Screen off after %u min", "%u 分钟后息屏"},
    {"Screen stays on", "屏幕保持常亮"},
    {"Back to Vibe Mode: hold AI and", "回到 Vibe Mode：按住 AI 键，"},
    {"double-press power to restart.", "双击开关机键重启。"},
    {"Getting started", "快速上手"},
    {"Set up and run your first Idea", "完成设置，运行第一个 Idea"},
    {"Build with your Agent", "与你的 Agent 一起开发"},
    {"Download from Mosaico Ideas", "从 Mosaico Ideas 下载"},
    {"Update Vibe Mode", "更新 Vibe Mode"},
    {"Install a new system version", "安装新的系统版本"},
    {"View on your phone", "在手机上查看"},
    {"Step-by-step guide", "分步操作指南"},
    {"Build your own Idea", "开发自己的 Idea"},
    {"with your Agent.", "与你的 Agent 一起。"},
    {"On this device", "已在本机"},
    {"SCREEN OFF AFTER", "自动息屏"},
    {"New key", "新建键名"},
    {"1 min", "1 分钟"},
    {"3 min", "3 分钟"},
    {"5 min", "5 分钟"},
    {"10 min", "10 分钟"},
    {"Every Idea can read this value.", "所有 Idea 都可以读取此值。"},
    {"a-z, 0-9 and _ · up to 15 characters", "a-z、0-9 和 _ · 最多 15 个字符"},
    {"Add Idea", "添加 Idea"},
    {"Type an ID from Mosaico Ideas,", "输入 Mosaico Ideas 上的 ID，"},
    {"or ask your agent to build one.", "或让你的 Agent 做一个。"},
    {"Current", "当前运行"},
    {"Update available", "有可用更新"},
    {"Ideas %u/%u", "Idea %u/%u"},
    {"%u Ideas · %llu.%u of %llu MB used", "%u 个 Idea · 已用 %llu.%u / %llu MB"},
    {"Do not unplug or power off.", "请勿断电或关机。"},
    {"Start update", "开始更新"},
    {"Firmware file not published yet", "固件文件尚未发布"},
    {"Downloading firmware", "正在下载固件"},
    {"Verifying firmware", "正在校验固件"},
    {"Writing firmware", "正在写入固件"},
    {"Restarting Vibe Mode", "正在重启 Vibe Mode"},
    {"Checking...", "正在检查…"},
    {"Up to date", "已是最新"},
    {"Check failed", "检查失败"},
    {"Stitch ideas, run now.", "拼接灵感，即刻运行。"},
    {"Open your next possibility", "打开你的下一种可能"},
    {"Scan for the coding guide", "扫码查看分步指南"},
    {"Save current build", "保存当前开发版"},
    {"The interface changes now.\nIdea names stay as published.", "整个系统界面会立即切换语言，已发布的 Idea 名称保持原样。"},
    {"20%", "20%"},
    {"40%", "40%"},
    {"60%", "60%"},
    {"80%", "80%"},
    {"100%", "100%"},
    {"MAC", "MAC 地址"},
    {"Open-source licenses", "开源许可"},
    {"Components used in Vibe Mode", "Vibe Mode 使用的组件"},
    {"Licenses & notices", "许可与声明"},
    {"Software components", "软件组件"},
    {"Fonts", "字体"},
    {"Full license text", "完整许可文本"},
    {"Delete entry", "删除条目"},
    {"Opening leaves Vibe Mode", "打开后将离开 Vibe Mode"},
    {"To come back to Vibe Mode:", "如何返回 Vibe Mode"},
    {"Wi-Fi not connected >", "Wi-Fi 未连接 >"},
    {"Wi-Fi not connected ›", "Wi-Fi 未连接 ›"},
    {"Device connected", "设备已连接"},
    {"Agent ready", "Agent 已就绪"},
    {"Waiting for Agent", "等待 Agent 连接"},
    {"Connect USB to develop", "连接 USB 开始开发"},
    {"No development build", "暂无开发版本"},
    {"Already saved", "已保存"},
    {"No development build to save", "暂无可保存的开发版本"},
    {"Already saved in My Ideas", "已保存到我的 Ideas"},
    {"Touch feedback", "操作触感反馈"},
    {"1  Hold AI and do not let go\n2  Then double-press power", "1  按住 AI 键不放\n2  再双击开关机键"},
    {"Vibe Mode uses ESP-IDF, ESP-Iris\nand a lightweight UI renderer.\nSee the source repository for\ncomponent licenses and notices.", "Vibe Mode 使用 ESP-IDF、\nESP-Iris 和轻量界面绘制器。\n组件许可与声明详见\n项目源代码仓库。"},
    {"Inter, Archivo and Noto Sans SC\nuse SIL Open Font License 1.1.\nDejaVu has separate font notices.\nThe notices ship with the source.", "Inter、Archivo 和 Noto Sans SC\n使用 SIL 开源字体许可 1.1。\nDejaVu 使用独立字体许可。\n许可声明随源代码提供。"},
    {"This page summarizes selected\ncomponents and fonts. Refer to\neach project's license files for\nthe full terms and attribution.", "此页概述部分组件与字体。\n完整条款和署名信息\n请参阅各项目的许可文件。"},
    {"Save a value once.\nEvery Idea can read it.", "保存一次信息，\n每个 Idea 都能读取。"},
    {"Keys: a-z, 0-9 and _\nUp to 15 characters.\nValues: up to 256 bytes.\nSecret values are hidden by default.", "键名使用 a-z、0-9 和 _，\n最多 15 个字符。\n值最多 256 字节。\n密文默认隐藏。"},
    {"Tap Value to edit this entry.", "点击「键名」或「内容」编辑此条目。"},
    {"Current Idea", "当前 Idea"},
    {"Update all saved Ideas?", "更新所有已保存的 Idea？"},
    {"Download available updates to My Ideas.", "将可用更新下载到我的应用。"},
    {"SSID must contain 1-32 bytes", "SSID:1-32字节"},
    {"Use 8-63 bytes or 64 hex digits", "密码:8-63字节或64位十六进制"},
    {"Completed updates are kept", "已完成更新保留"},
    {"Enter text", "输入"},
    {"Unavailable", "不可用"},
    {"Starting...", "启动中…"},
    {"Retry", "重试"},
    {"Your saved files are kept.", "保存的文件仍在。"},
    {"You can undo for 4 seconds.", "删除后 4 秒内可以撤销。"},
    {"NAND unavailable", "NAND 不可用"},
    {"Initialize NAND Flash?", "是否初始化 NAND Flash？"},
    {"NAND initialization or reading failed. Formatting erases all files and saved Ideas on NAND.", "NAND 初始化或读取失败。格式化将清除 NAND 上的所有文件和已保存的 Ideas。"},
    {"Format NAND", "格式化 NAND"},
    {"Format", "格式化"},
    {"Formatting NAND", "正在格式化 NAND"},
    {"NAND formatted", "NAND 格式化完成"},
    {"Format failed", "格式化失败"},
    {"You can download Ideas again.", "现在可以重新下载 Ideas。"},
    {"Preparing storage for writing", "正在准备写入空间"},
    {"Snap ideas together.", "拼接灵感，即刻运行。"},
    {"Choose Your Language", "选择语言"},
    {"Change later in Settings.", "之后可在「设置」里更改。"},
    {"Tap or press AI to wake", "轻点屏幕或按 AI 键唤醒"},
    {"Running Leaves Vibe Mode", "运行后将离开 Vibe Mode"},
    {"To return to Vibe Mode:", "返回 Vibe Mode 的方法："},
    {"1  Power off the device\n2  Hold AI and turn it on\n3  Release AI in Vibe Mode.", "1  先关闭设备\n2  按住 AI 键开机\n3  进入 Vibe Mode 后松开 AI 键。"},
    {"Run current build", "运行当前开发版"},
    {"Feedback for active controls", "操作有效时轻震"},
    {"Power off; hold Boot while turning on.\nThe chip enters ROM Download Mode.\nRelease Boot after entering ROM.", "先关闭设备，再按住 Boot 键开机。\n芯片将进入 ROM 下载模式。\n进入 ROM 模式后松开 Boot 键。"},
    {"Vibe Coding", "Vibe 编程"},
    {"Getting Started", "快速上手"},
    {"Develop Ideas", "开发 Idea"},
    {"Idea IDs & Sharing", "Idea 编号与分享"},
    {"Troubleshooting", "常见问题"},
    {"Wi-Fi, storage & recovery", "Wi-Fi、存储空间与返回方法"},
    {"Use the 6-digit ID to find & install", "用六位编号查找和安装"},
    {"Scan for the coding guide.", "扫码查看开发指南。"},
    {"Scan for the starter guide.", "扫码查看快速上手指南。"},
    {"Scan for the ID & sharing guide.", "扫码查看编号与分享指南。"},
    {"Scan for the troubleshooting guide.", "扫码查看问题排查指南。"},
    {"FOR EXAMPLE", "示例"},
    {"read by Weather", "Weather 读取"},
    {"read by Skills", "Skills 读取"},
    {"Read-only system setting · tap to open Settings", "系统只读设置 · 点击打开设置"},
    {"Open Settings", "打开设置"},
    {"Clear Wi-Fi, shared information\nand system preferences.\nIdeas: Kept on this device.", "清除 Wi-Fi、共享信息和系统偏好。\nIdeas：保留在本机。"},
    {"Restarts to run this Idea.", "设备会重启，然后运行这个 Idea。"},
    {"Power off the device", "先关闭设备"},
    {"Hold AI and turn it on", "按住 AI 键开机"},
    {"Release AI in Vibe Mode.", "进入 Vibe Mode 后松开 AI 键。"},
    {"Don't show this again", "下次不再提示"},
    {"Power off; hold Boot while turning on.", "先关机，再按住 Boot 键开机。"},
    {"Scan for the steps\nand what's new.", "扫码查看升级步骤\n与新版本说明。"},
    {"Release Boot after entering ROM.", "进入 ROM 下载模式后松开 Boot 键。"},
    {"Hold Boot", "按住 Boot 键"},
    {"Turn on", "再开机"},
    {"Clears settings, then restarts:", "清除设置后重启："},
    {"Kept on this device", "保留在本机"},
    {"Display & haptics, language", "显示与触感、语言"},
    {"Ideas, app data and Vibe Mode stay.", "保留 Idea、应用数据和 Vibe Mode。"},
    {"ESP-IDF · ESP-Iris", "ESP-IDF · ESP-Iris"},
    {"Apache License 2.0", "Apache License 2.0"},
    {"ESP-GSP · VUI", "ESP-GSP · VUI"},
    {"Espressif Modified MIT License", "Espressif Modified MIT License"},
    {"LZMA SDK", "LZMA SDK"},
    {"Public domain", "公有领域"},
    {"Inter · Archivo · Doto", "Inter · Archivo · Doto"},
    {"SIL Open Font License 1.1", "SIL Open Font License 1.1"},
    {"Noto Sans SC", "Noto Sans SC"},
    {"DejaVu", "DejaVu"},
    {"Separate font license notices", "独立字体许可声明"},
    {"Other components retain their own licenses and copyright notices.", "其他组件保留各自的许可证和版权声明。"},
    {"Full terms and copyright notices are in each project's license files.", "完整条款和版权声明请查阅各项目的许可证文件。"},
    {"Build one with your AI agent", "和 AI Agent 一起做 Idea"},
    {"Find, download and share", "查找、下载与分享"},
    {"Wi-Fi, storage, stuck Ideas", "Wi-Fi、存储空间、Idea 卡住"},
    {"Plug in USB and ask your agent to build an Idea.", "连接 USB，让 AI 帮你制作 Idea。"},
    {"Or download one: open Manage, tap +, type its ID.", "也可在「管理」下载 Idea：点击 +，输入六位编号。"},
    {"Power off. Hold AI and power on.\nRelease AI in Vibe Mode.", "关机后，按住 AI 键再开机；进入\nVibe Mode 后松开 AI 键。"},
    {"Open the Vibe-coding guide and\nfollow it in your AI agent.", "打开 Vibe Coding 指南，用 AI Agent 完成制作。"},
    {"Plug in USB. The agent installs the\nIdea over the cable.", "连接 USB，Agent 会安装 Idea。"},
    {"Check Develop for USB and agent status.", "在「开发」查看连接状态。"},
    {"Every Idea has a 6-digit ID shown\non Mosaico Ideas.", "每个 Idea 的 6 位编号都能在 Mosaico Ideas 上找到。"},
    {"Open Manage, tap +, type the ID\nand press Go.", "到「管理」点 +，输入编号后查找。"},
    {"Share your own Idea to get an ID\nfor friends.", "分享 Idea，把编号发给朋友。"},
    {"Power off the device.", "先关闭设备。"},
    {"Hold AI and turn the device on.", "按住 AI 键，再开机。"},
    {"Release AI when Vibe Mode appears.", "进入 Vibe Mode 后，松开 AI 键。"},
    {"Full guide on your phone", "在手机上看完整指南"},
    {"Wi-Fi Connection", "Wi-Fi 连接"},
    {"Check networks and passwords", "检查网络与密码"},
    {"Storage Is Full", "存储空间不足"},
    {"Manage installed Ideas", "管理已安装的 Idea"},
    {"Return to Vibe Mode", "返回 Vibe Mode"},
    {"View the AI-key startup steps", "查看 AI 键开机步骤"},
    {"Vibe Coding Guide", "Vibe Coding 指南"},
    {"Build your first Idea with AI.", "用 AI 创建你的第一个 Idea。"},
    {"Set up and run your first Idea.", "完成设置，运行第一个 Idea。"},
    {"Find Idea IDs and share your own.", "查找 Idea 编号，分享你的作品。"},
    {"Help with Wi-Fi, storage and Ideas.", "Wi-Fi、存储与 Idea 问题指南。"},
    {"Read-only. Change this value in Settings.", "此处仅供查看，请在对应设置中修改。"},
    {"Sleep", "息屏"},
    {"Open Wi-Fi Settings and check\nthat Wi-Fi is on.", "打开 Wi-Fi 设置，确认 Wi-Fi 已开启。"},
    {"Select your network and enter\nthe correct password.", "选择要连接的网络，输入正确的密码。"},
    {"If connection fails, check the\npassword and scan again.", "连接失败时，检查密码后重新扫描。"},
    {"Open Manage Storage to check\nyour Ideas and storage usage.", "打开存储管理，查看已安装的 Idea 和可用空间。"},
    {"Delete an Idea you no longer need\nto free space.", "删除不再需要的 Idea，空出存储空间。"},
    {"The current Idea cannot be deleted.\nRun another Idea first.", "当前应用无法删除，请先运行其他 Idea。"},
    {"Wi-Fi Settings", "Wi-Fi 设置"},
    {"Manage Storage", "管理存储空间"},
    {"Checking apps and storage...", "正在检查应用和存储空间…"},
};
static const struct { uint16_t bind; const char *text; } vibe_static_labels[] = {
    {VUI_VIBE_BIND_PAIRING_ENDPOINT, "Connect Wi-Fi first"},
    {VUI_VIBE_BIND_PAIRING_TOKEN, "Available after startup"},
    {VUI_VIBE_BIND_DELETE_PROGRESS, "Hold for 3 seconds to delete"},
    {VUI_VIBE_BIND_HOME_BRAND, "Vibe Mode"},
    {VUI_VIBE_BIND_HOME_HEADLINE, "make ideas"},
    {VUI_VIBE_BIND_HOME_RUN, "run"},
    {VUI_VIBE_BIND_HOME_CAPTION, "Snap ideas together."},
    {VUI_VIBE_BIND_HOME_WIFI_BTN_LABEL, "Wi-Fi not connected ›"},
    {VUI_VIBE_BIND_HOME_IDEAS_TITLE, "My Ideas"},
    {VUI_VIBE_BIND_HOME_IDEAS_SUB, "Open your next possibility"},
    {VUI_VIBE_BIND_NAV_DEVELOP_LABEL, "Develop"},
    {VUI_VIBE_BIND_NAV_MANAGE_LABEL, "Manage"},
    {VUI_VIBE_BIND_NAV_SETTINGS_LABEL, "Settings"},
    {VUI_VIBE_BIND_HEADING_15, "Wi-Fi"},
    {VUI_VIBE_BIND_HEADING_39, "TCP pairing"},
    {VUI_VIBE_BIND_HEADING_49, "Download Idea"},
    {VUI_VIBE_BIND_HEADING_59, "Manage"},
    {VUI_VIBE_BIND_HEADING_143, "Develop"},
    {VUI_VIBE_BIND_HEADING_147, "Settings"},
    {VUI_VIBE_BIND_HEADING_156, "Display & haptics"},
    {VUI_VIBE_BIND_HEADING_174, "Language"},
    {VUI_VIBE_BIND_HEADING_186, "Shared info"},
    {VUI_VIBE_BIND_HEADING_205, "About"},
    {VUI_VIBE_BIND_HEADING_214, "Factory reset"},
    {VUI_VIBE_BIND_DELETE_CONFIRM_TITLE, "Delete Idea"},
    {VUI_VIBE_BIND_HEADING_272, "Update Vibe Mode"},
    {VUI_VIBE_BIND_HELP_HEADING, "Help"},
    {VUI_VIBE_BIND_ROW_TITLE_HELP_0, "Getting started"},
    {VUI_VIBE_BIND_ROW_SUB_HELP_0, "Set up and run your first Idea"},
    {VUI_VIBE_BIND_ROW_TITLE_HELP_1, "Develop Ideas"},
    {VUI_VIBE_BIND_ROW_SUB_HELP_1, "Build one with your AI agent"},
    {VUI_VIBE_BIND_ROW_TITLE_HELP_2, "Idea IDs & Sharing"},
    {VUI_VIBE_BIND_ROW_SUB_HELP_2, "Find, download and share"},
    {VUI_VIBE_BIND_ROW_TITLE_HELP_3, "Troubleshooting"},
    {VUI_VIBE_BIND_ROW_SUB_HELP_3, "Wi-Fi, storage, stuck Ideas"},
    {VUI_VIBE_BIND_HELP_STEP_NUM_1, "1"},
    {VUI_VIBE_BIND_HELP_STEP_BODY_1, "Plug in USB and ask your agent to build an Idea."},
    {VUI_VIBE_BIND_HELP_STEP_NUM_2, "2"},
    {VUI_VIBE_BIND_HELP_STEP_BODY_2, "Plug in USB and ask your agent to build an Idea."},
    {VUI_VIBE_BIND_HELP_STEP_NUM_3, "3"},
    {VUI_VIBE_BIND_HELP_STEP_BODY_3, "Plug in USB and ask your agent to build an Idea."},
    {VUI_VIBE_BIND_HELP_QR_CAPTION, "Full guide on your phone"},
    {VUI_VIBE_BIND_ROW_TITLE_FIX_0, "Wi-Fi Connection"},
    {VUI_VIBE_BIND_ROW_SUB_FIX_0, "Check networks and passwords"},
    {VUI_VIBE_BIND_ROW_TITLE_FIX_1, "Storage Is Full"},
    {VUI_VIBE_BIND_ROW_SUB_FIX_1, "Manage installed Ideas"},
    {VUI_VIBE_BIND_ROW_TITLE_FIX_2, "Return to Vibe Mode"},
    {VUI_VIBE_BIND_ROW_SUB_FIX_2, "View the AI-key startup steps"},
    {VUI_VIBE_BIND_FIX_QR_CAPTION, "Full guide on your phone"},
    {VUI_VIBE_BIND_GUIDE_HEADING, "View on your phone"},
    {VUI_VIBE_BIND_GUIDE_ONE, "Scan for the coding guide."},
    {VUI_VIBE_BIND_GUIDE_URL, "mosaico.espressif.com/guide/vibe-coding"},
    {VUI_VIBE_BIND_BOOT_TIP_TOP, "Power off; hold Boot while turning on."},
    {VUI_VIBE_BIND_BOOT_NOTE, "Scan for the steps\nand what's new."},
    {VUI_VIBE_BIND_BOOT_TIP_URL, "mosaico.espressif.com/\nvibe/update"},
    {VUI_VIBE_BIND_BOOT_TIP_HOW, "Release Boot after entering ROM."},
    {VUI_VIBE_BIND_BOOT_KEY_1_NUM, "1"},
    {VUI_VIBE_BIND_BOOT_KEY_1_TEXT, "Hold Boot"},
    {VUI_VIBE_BIND_BOOT_KEY_2_NUM, "2"},
    {VUI_VIBE_BIND_BOOT_KEY_2_TEXT, "Turn on"},
    {VUI_VIBE_BIND_DEVELOP_EYEBROW, "USB / AGENT"},
    {VUI_VIBE_BIND_ROW_TITLE_DEVELOP_RUN, "Run current build"},
    {VUI_VIBE_BIND_ROW_TITLE_DEVELOP_SAVE, "Save current build"},
    {VUI_VIBE_BIND_ROW_TITLE_DEVELOP_GUIDE, "Vibe-code an Idea"},
    {VUI_VIBE_BIND_ROW_SUB_DEVELOP_GUIDE, "Scan for the coding guide"},
    {VUI_VIBE_BIND_ROW_TITLE_SETTINGS_TOP_WIFI, "Wi-Fi"},
    {VUI_VIBE_BIND_ROW_TITLE_SETTINGS_TOP_DISPLAY, "Display & haptics"},
    {VUI_VIBE_BIND_SETTINGS_TOP_DISPLAY_SUB, "Screen off after 3 min"},
    {VUI_VIBE_BIND_ROW_TITLE_SETTINGS_TOP_LANGUAGE, "Language"},
    {VUI_VIBE_BIND_SETTINGS_TOP_LANGUAGE_SUB, "English"},
    {VUI_VIBE_BIND_ROW_TITLE_SETTINGS_TOP_SHARED, "Shared info"},
    {VUI_VIBE_BIND_ROW_TITLE_SETTINGS_BOTTOM_HELP, "Help"},
    {VUI_VIBE_BIND_SETTINGS_BOTTOM_HELP_SUB, "Get started with Vibe Mode"},
    {VUI_VIBE_BIND_ROW_TITLE_SETTINGS_BOTTOM_ABOUT, "About"},
    {VUI_VIBE_BIND_SETTINGS_BOTTOM_ABOUT_SUB, "Version · device · storage"},
    {VUI_VIBE_BIND_ROW_TITLE_SETTINGS_BOTTOM_RESET, "Factory reset"},
    {VUI_VIBE_BIND_SETTINGS_BOTTOM_RESET_SUB, "Clear preferences · keep NAND"},
    {VUI_VIBE_BIND_LIBRARY_EMPTY_TITLE, "No Ideas yet"},
    {VUI_VIBE_BIND_LIBRARY_EMPTY_NOTE, "Tap + to download your first Idea."},
    {VUI_VIBE_BIND_STATIC_468, "Retry"},
    {VUI_VIBE_BIND_UNDO_DELETE_LABEL, "Undo"},
    {VUI_VIBE_BIND_BRIDGE_DETAIL, "Enter the 6-digit ID from Mosaico Ideas"},
    {VUI_VIBE_BIND_STATIC_499, "1"},
    {VUI_VIBE_BIND_STATIC_500, "2"},
    {VUI_VIBE_BIND_STATIC_501, "3"},
    {VUI_VIBE_BIND_STATIC_502, "4"},
    {VUI_VIBE_BIND_STATIC_503, "5"},
    {VUI_VIBE_BIND_STATIC_504, "6"},
    {VUI_VIBE_BIND_STATIC_505, "7"},
    {VUI_VIBE_BIND_STATIC_506, "8"},
    {VUI_VIBE_BIND_STATIC_507, "9"},
    {VUI_VIBE_BIND_STATIC_508, "0"},
    {VUI_VIBE_BIND_STATIC_511, "Go"},
    {VUI_VIBE_BIND_WIFI_CONNECTION, "Not connected"},
    {VUI_VIBE_BIND_WIFI_DETAIL, "Choose a network below"},
    {VUI_VIBE_BIND_STATIC_517, "Forget"},
    {VUI_VIBE_BIND_WIFI_SCAN, "Available networks"},
    {VUI_VIBE_BIND_PASSWORD_DISPLAY, "Enter password"},
    {VUI_VIBE_BIND_LOCAL_STATUS, "On this device"},
    {VUI_VIBE_BIND_STATIC_549, "Check updates"},
    {VUI_VIBE_BIND_STATIC_550, "View info"},
    {VUI_VIBE_BIND_BUTTON_UPDATE_IDEA_CAPTION, "Update"},
    {VUI_VIBE_BIND_BUTTON_INSTALL_CAPTION, "Run"},
    {VUI_VIBE_BIND_BUTTON_START_IDEA_CAPTION, "Delete"},
    {VUI_VIBE_BIND_BUTTON_LOCAL_OPEN_CAPTION, "Run"},
    {VUI_VIBE_BIND_BUTTON_LOCAL_DELETE_CAPTION, "Delete"},
    {VUI_VIBE_BIND_IDEA_NAME, "Loading app information..."},
    {VUI_VIBE_BIND_IDEA_LOADING_STATUS, "Please wait"},
    {VUI_VIBE_BIND_IDEA_DESCRIPTION, "Fetching details from the cloud"},
    {VUI_VIBE_BIND_STATIC_583, "Cancel"},
    {VUI_VIBE_BIND_IDEA_ACCEPT, "Download"},
    {VUI_VIBE_BIND_LANGUAGE_EN_LABEL, "English"},
    {VUI_VIBE_BIND_LANGUAGE_ZH_LABEL, "简体中文"},
    {VUI_VIBE_BIND_LANGUAGE_EN_SELECTED_LABEL, "English"},
    {VUI_VIBE_BIND_LANGUAGE_ZH_SELECTED_LABEL, "简体中文"},
    {VUI_VIBE_BIND_LANGUAGE_EXPLANATION, "The interface changes now.\nIdea names stay as published."},
    {VUI_VIBE_BIND_WELCOME_EN_LABEL, "English"},
    {VUI_VIBE_BIND_WELCOME_ZH_LABEL, "简体中文"},
    {VUI_VIBE_BIND_WELCOME_EN_SELECTED_LABEL, "English"},
    {VUI_VIBE_BIND_WELCOME_ZH_SELECTED_LABEL, "简体中文"},
    {VUI_VIBE_BIND_WELCOME_HEADING, "Choose Your Language"},
    {VUI_VIBE_BIND_WELCOME_CHINESE, "选择语言"},
    {VUI_VIBE_BIND_WELCOME_LATER, "Change later in Settings."},
    {VUI_VIBE_BIND_WELCOME_LATER_ZH, "之后可在「设置」里更改。"},
    {VUI_VIBE_BIND_BRIGHTNESS_TITLE, "BRIGHTNESS"},
    {VUI_VIBE_BIND_TIMEOUT_TITLE, "SCREEN OFF AFTER"},
    {VUI_VIBE_BIND_BRIGHTNESS_0_LABEL, "20%"},
    {VUI_VIBE_BIND_TIMEOUT_0_LABEL, "1 min"},
    {VUI_VIBE_BIND_BRIGHTNESS_SELECTED_0_LABEL, "20%"},
    {VUI_VIBE_BIND_TIMEOUT_SELECTED_0_LABEL, "1 min"},
    {VUI_VIBE_BIND_BRIGHTNESS_1_LABEL, "40%"},
    {VUI_VIBE_BIND_TIMEOUT_1_LABEL, "3 min"},
    {VUI_VIBE_BIND_BRIGHTNESS_SELECTED_1_LABEL, "40%"},
    {VUI_VIBE_BIND_TIMEOUT_SELECTED_1_LABEL, "3 min"},
    {VUI_VIBE_BIND_BRIGHTNESS_2_LABEL, "60%"},
    {VUI_VIBE_BIND_TIMEOUT_2_LABEL, "5 min"},
    {VUI_VIBE_BIND_BRIGHTNESS_SELECTED_2_LABEL, "60%"},
    {VUI_VIBE_BIND_TIMEOUT_SELECTED_2_LABEL, "5 min"},
    {VUI_VIBE_BIND_BRIGHTNESS_3_LABEL, "80%"},
    {VUI_VIBE_BIND_TIMEOUT_3_LABEL, "10 min"},
    {VUI_VIBE_BIND_BRIGHTNESS_SELECTED_3_LABEL, "80%"},
    {VUI_VIBE_BIND_TIMEOUT_SELECTED_3_LABEL, "10 min"},
    {VUI_VIBE_BIND_BRIGHTNESS_4_LABEL, "100%"},
    {VUI_VIBE_BIND_TIMEOUT_4_LABEL, "Never"},
    {VUI_VIBE_BIND_BRIGHTNESS_SELECTED_4_LABEL, "100%"},
    {VUI_VIBE_BIND_TIMEOUT_SELECTED_4_LABEL, "Never"},
    {VUI_VIBE_BIND_ROW_TITLE_DISPLAY_0_ROTATE, "Auto rotate"},
    {VUI_VIBE_BIND_DISPLAY_ROTATE_SUB, "Follows how you hold it"},
    {VUI_VIBE_BIND_ROW_TITLE_DISPLAY_0_HAPTICS, "Haptics"},
    {VUI_VIBE_BIND_DISPLAY_HAPTICS_SUB, "Touch feedback"},
    {VUI_VIBE_BIND_STATIC_894, "Add entry"},
    {VUI_VIBE_BIND_SHARED_EMPTY_TITLE, "No shared info yet"},
    {VUI_VIBE_BIND_SHARED_EMPTY_LINE1, "Save a value once, like your city,"},
    {VUI_VIBE_BIND_SHARED_EMPTY_LINE2, "and every Idea can read it."},
    {VUI_VIBE_BIND_SHARED_EDITOR_HEADING, "New key"},
    {VUI_VIBE_BIND_SHARED_FIELD, "Key"},
    {VUI_VIBE_BIND_SHARED_DELETE_LABEL, "Delete"},
    {VUI_VIBE_BIND_ABOUT_KEY_0, "Version"},
    {VUI_VIBE_BIND_ABOUT_KEY_1, "Device"},
    {VUI_VIBE_BIND_ABOUT_DEVICE, "ESP-Mosaico"},
    {VUI_VIBE_BIND_ABOUT_KEY_2, "MAC"},
    {VUI_VIBE_BIND_ABOUT_KEY_3, "Storage"},
    {VUI_VIBE_BIND_ROW_TITLE_ABOUT_CHECK, "Update Vibe Mode"},
    {VUI_VIBE_BIND_ABOUT_CHECK, "Check updates"},
    {VUI_VIBE_BIND_ROW_TITLE_ABOUT_LICENSES, "Open-source licenses"},
    {VUI_VIBE_BIND_ROW_SUB_ABOUT_LICENSES, "Components used in Vibe Mode"},
    {VUI_VIBE_BIND_ROW_TITLE_ABOUT_DOWNLOAD, "Find Ideas"},
    {VUI_VIBE_BIND_ROW_SUB_ABOUT_DOWNLOAD, "Browse Mosaico Ideas"},
    {VUI_VIBE_BIND_HEADING_998, "Licenses & notices"},
    {VUI_VIBE_BIND_LICENSES_HEADING_8, "Software components"},
    {VUI_VIBE_BIND_LICENSES_COMP_0, "ESP-IDF · ESP-Iris"},
    {VUI_VIBE_BIND_LICENSES_LIC_0, "Apache License 2.0"},
    {VUI_VIBE_BIND_LICENSES_COMP_1, "ESP-GSP · VUI"},
    {VUI_VIBE_BIND_LICENSES_LIC_1, "Espressif Modified MIT License"},
    {VUI_VIBE_BIND_LICENSES_COMP_2, "LZMA SDK"},
    {VUI_VIBE_BIND_LICENSES_LIC_2, "Public domain"},
    {VUI_VIBE_BIND_LICENSES_HEADING_248, "Fonts"},
    {VUI_VIBE_BIND_LICENSES_COMP_3, "Inter · Archivo · Doto"},
    {VUI_VIBE_BIND_LICENSES_LIC_3, "SIL Open Font License 1.1"},
    {VUI_VIBE_BIND_LICENSES_COMP_4, "Noto Sans SC"},
    {VUI_VIBE_BIND_LICENSES_LIC_4, "SIL Open Font License 1.1"},
    {VUI_VIBE_BIND_LICENSES_COMP_5, "DejaVu"},
    {VUI_VIBE_BIND_LICENSES_LIC_5, "Separate font license notices"},
    {VUI_VIBE_BIND_LICENSES_BODY_8, "Other components retain their own licenses and copyright notices."},
    {VUI_VIBE_BIND_LICENSES_BODY_248, "Full terms and copyright notices are in each project's license files."},
    {VUI_VIBE_BIND_HEADING_1029, "Shared info"},
    {VUI_VIBE_BIND_SHARED_HELP_INTRO, "Save a value once.\nEvery Idea can read it."},
    {VUI_VIBE_BIND_SHARED_HELP_EXAMPLE_TITLE, "FOR EXAMPLE"},
    {VUI_VIBE_BIND_SHARED_HELP_EX0_K, "city"},
    {VUI_VIBE_BIND_SHARED_HELP_EX0_V, "read by Weather"},
    {VUI_VIBE_BIND_SHARED_HELP_EX1_K, "api_key"},
    {VUI_VIBE_BIND_SHARED_HELP_EX1_V, "read by Skills"},
    {VUI_VIBE_BIND_SHARED_HELP_RULES, "Keys: a-z, 0-9 and _ · up to 15 characters\nValues: up to 256 bytes"},
    {VUI_VIBE_BIND_HEADING_1043, "Shared info"},
    {VUI_VIBE_BIND_ROW_TITLE_SHARED_DETAIL_KEY, "Key"},
    {VUI_VIBE_BIND_ROW_TITLE_SHARED_DETAIL_VALUE, "Value"},
    {VUI_VIBE_BIND_SHARED_DETAIL_NOTE, "Tap Value to edit this entry."},
    {VUI_VIBE_BIND_STATIC_1019, "Delete entry"},
    {VUI_VIBE_BIND_SHARED_DETAIL_OPEN_SETTINGS_LABEL, "Open Settings"},
    {VUI_VIBE_BIND_OPEN_KEY_AI_NUM, "2"},
    {VUI_VIBE_BIND_OPEN_KEY_PWR_NUM, "1"},
    {VUI_VIBE_BIND_OPEN_QUESTION, "Running Leaves Vibe Mode"},
    {VUI_VIBE_BIND_OPEN_HOW, "To come back to Vibe Mode:"},
    {VUI_VIBE_BIND_OPEN_STEP_NUM_1, "1"},
    {VUI_VIBE_BIND_OPEN_STEP_TEXT_1, "Power off the device"},
    {VUI_VIBE_BIND_OPEN_STEP_NUM_2, "2"},
    {VUI_VIBE_BIND_OPEN_STEP_TEXT_2, "Hold AI and turn it on"},
    {VUI_VIBE_BIND_OPEN_STEP_NUM_3, "3"},
    {VUI_VIBE_BIND_OPEN_STEP_TEXT_3, "Release AI in Vibe Mode."},
    {VUI_VIBE_BIND_OPEN_SKIP_CAPTION, "Don't show this again"},
    {VUI_VIBE_BIND_OPEN_CANCEL_LABEL, "Cancel"},
    {VUI_VIBE_BIND_OPEN_ACCEPT_CAPTION, "Run"},
    {VUI_VIBE_BIND_GRID_BRAND, "Vibe Mode"},
    {VUI_VIBE_BIND_GRID_EMPTY_ADD, "Add Idea"},
    {VUI_VIBE_BIND_GRID_EMPTY_TITLE, "No Ideas yet"},
    {VUI_VIBE_BIND_GRID_EMPTY_LINE1, "Type an ID from Mosaico Ideas,"},
    {VUI_VIBE_BIND_GRID_EMPTY_LINE2, "or ask your agent to build one."},
    {VUI_VIBE_BIND_UPDATE_POWER_NOTE, "Keep power connected until restart."},
    {VUI_VIBE_BIND_CANCEL_DOWNLOAD_LABEL, "Cancel"},
    {VUI_VIBE_BIND_RESULT_LIBRARY_LABEL, "Done"},
    {VUI_VIBE_BIND_RESULT_OPEN_CAPTION, "Run"},
    {VUI_VIBE_BIND_STATIC_1238, "Done"},
    {VUI_VIBE_BIND_HEADING_1244, "Update all"},
    {VUI_VIBE_BIND_UPDATE_CONFIRM_QUESTION, "Update all saved Ideas?"},
    {VUI_VIBE_BIND_UPDATE_CONFIRM_NOTE, "Download available updates to My Ideas."},
    {VUI_VIBE_BIND_STATIC_1246, "Cancel"},
    {VUI_VIBE_BIND_STATIC_1247, "Update all"},
    {VUI_VIBE_BIND_STATIC_1248, "Format NAND"},
    {VUI_VIBE_BIND_HEADING_1254, "NAND unavailable"},
    {VUI_VIBE_BIND_FORMAT_NAND_QUESTION, "Initialize NAND Flash?"},
    {VUI_VIBE_BIND_FORMAT_NAND_NOTE, "NAND initialization or reading failed. Formatting erases all files and saved Ideas on NAND."},
    {VUI_VIBE_BIND_STATIC_1256, "Cancel"},
    {VUI_VIBE_BIND_STATIC_1257, "Format"},
    {VUI_VIBE_BIND_RESET_BODY, "Clears settings, then restarts:"},
    {VUI_VIBE_BIND_RESET_KEY_0, "Ideas"},
    {VUI_VIBE_BIND_RESET_VAL_0, "Kept on this device"},
    {VUI_VIBE_BIND_RESET_KEY_1, "Wi-Fi"},
    {VUI_VIBE_BIND_RESET_VAL_1, "Not connected"},
    {VUI_VIBE_BIND_RESET_KEY_2, "Shared info"},
    {VUI_VIBE_BIND_RESET_VAL_2, "0 entries"},
    {VUI_VIBE_BIND_RESET_KEY_3, "Settings"},
    {VUI_VIBE_BIND_RESET_VAL_3, "Display & haptics, language"},
    {VUI_VIBE_BIND_RESET_HOLD_LABEL, "Hold to reset"},
    {VUI_VIBE_BIND_DELETE_NOTE, "Remove this saved Idea?\nYou can undo for 4 seconds."},
    {VUI_VIBE_BIND_DELETE_HOLD_LABEL, "Hold to delete"},
    {VUI_VIBE_BIND_SLEEP_MESSAGE, "Tap or press AI to wake"},
    {VUI_VIBE_BIND_BACK_FIRMWARE_NOTICE_LABEL, "‹"},
    {VUI_VIBE_BIND_FIRMWARE_NOTICE_TITLE, "Update Vibe Mode"},
    {VUI_VIBE_BIND_FIRMWARE_AVAILABLE, "Update available"},
    {VUI_VIBE_BIND_FIRMWARE_WARNING, "Do not unplug or power off."},
    {VUI_VIBE_BIND_FIRMWARE_LATER_LABEL, "Skip"},
    {VUI_VIBE_BIND_FIRMWARE_START_LABEL, "Start update"},
    {VUI_VIBE_BIND_FIRMWARE_PROGRESS_TITLE, "Updating firmware"},
    {VUI_VIBE_BIND_FIRMWARE_POWER_WARNING, "Do not unplug or power off."},
    {VUI_VIBE_BIND_FIRMWARE_FAILURE_BACK_LABEL, "Back"},
};
